# file: nucleo_f446re_register_gpio.ioc
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Mcu.Family=STM32F4
Mcu.Name=STM32F446R(C-E)Tx
Mcu.Package=LQFP64
NVIC.PriorityGroup=NVIC_PRIORITYGROUP_4
PA13.Mode=Serial_Wire
PA13.Signal=SYS_JTMS-SWDIO
PA14.Mode=Serial_Wire
PA14.Signal=SYS_JTCK-SWCLK
ProjectManager.HeapSize=0x200
ProjectManager.StackSize=0x400
ProjectManager.TargetToolchain=STM32CubeIDE
RCC.CortexFreq_Value=16000000
RCC.USBFreq_Value=96000000
RCC.VCOOutputFreq_Value=192000000
board=custom

// file: Core/Src/main.c
/* USER CODE BEGIN Header */
/**
  ******************************************************************************
  * @file           : main.c
  * @brief          : Main program body
  ******************************************************************************
  * @attention
  *
  * Copyright (c) 2026 STMicroelectronics.
  * All rights reserved.
  *
  * This software is licensed under terms that can be found in the LICENSE file
  * in the root directory of this software component.
  * If no LICENSE file comes with this software, it is provided AS-IS.
  *
  ******************************************************************************
  */
/* USER CODE END Header */
#include "main.h"

/* USER CODE BEGIN PD */

#define LED_PIN_PA5 5u
#define LED_PIN_PB12 12u
#define BUTTON_PIN 13u
#define BUTTON_ADD 1u
#define BUTTON_SUB 2u

#define LED_SHOW_MS 500u
#define BUTTON_SAMPLE_MS 20u

/* USER CODE END PD */

/* USER CODE BEGIN PV */

static uint8_t value = 0u;
static uint32_t last_button_tick = 0u;
static uint32_t addBtn_last = 1u;
static uint32_t subBtn_last = 1u;

/* USER CODE END PV */

void SystemClock_Config(void);
static void MX_GPIO_Init(void);
/* USER CODE BEGIN PFP */

static void gpio_register_init(void);
static void leds_show(uint32_t value);
static void run_button_task(void);

/* USER CODE END PFP */

int main(void)
{

  /* MCU Configuration--------------------------------------------------------*/

  /* Reset of all peripherals, Initializes the Flash interface and the Systick. */
  HAL_Init();

  /* Configure the system clock */
  SystemClock_Config();

  /* Initialize all configured peripherals */
  MX_GPIO_Init();
  /* USER CODE BEGIN 2 */

  gpio_register_init();

  /* USER CODE END 2 */

  /* Infinite loop */
  while (1)
  {

    /* USER CODE BEGIN 3 */

	  if ((GPIOC->IDR & (1u << BUTTON_PIN)) == 0){
		  GPIOA->BSRR = (1u << LED_PIN_PA5);
	  }
	  else {
		  GPIOA->BSRR = (1u << (LED_PIN_PA5 + 16));
	  }

	  run_button_task();
  }
  /* USER CODE END 3 */
}

void SystemClock_Config(void)
{
  RCC_OscInitTypeDef RCC_OscInitStruct = {0};
  RCC_ClkInitTypeDef RCC_ClkInitStruct = {0};

  /** Configure the main internal regulator output voltage
  */
  __HAL_RCC_PWR_CLK_ENABLE();
  __HAL_PWR_VOLTAGESCALING_CONFIG(PWR_REGULATOR_VOLTAGE_SCALE3);

  /** Initializes the RCC Oscillators according to the specified parameters
  * in the RCC_OscInitTypeDef structure.
  */
  RCC_OscInitStruct.OscillatorType = RCC_OSCILLATORTYPE_HSI;
  RCC_OscInitStruct.HSIState = RCC_HSI_ON;
  RCC_OscInitStruct.HSICalibrationValue = RCC_HSICALIBRATION_DEFAULT;
  RCC_OscInitStruct.PLL.PLLState = RCC_PLL_NONE;
  if (HAL_RCC_OscConfig(&RCC_OscInitStruct) != HAL_OK)
  {
    Error_Handler();
  }

  /** Initializes the CPU, AHB and APB buses clocks
  */
  RCC_ClkInitStruct.ClockType = RCC_CLOCKTYPE_HCLK|RCC_CLOCKTYPE_SYSCLK
                              |RCC_CLOCKTYPE_PCLK1|RCC_CLOCKTYPE_PCLK2;
  RCC_ClkInitStruct.SYSCLKSource = RCC_SYSCLKSOURCE_HSI;
  RCC_ClkInitStruct.AHBCLKDivider = RCC_SYSCLK_DIV1;
  RCC_ClkInitStruct.APB1CLKDivider = RCC_HCLK_DIV1;
  RCC_ClkInitStruct.APB2CLKDivider = RCC_HCLK_DIV1;

  if (HAL_RCC_ClockConfig(&RCC_ClkInitStruct, FLASH_LATENCY_0) != HAL_OK)
  {
    Error_Handler();
  }
}

static void MX_GPIO_Init(void)
{

  /* GPIO Ports Clock Enable */
  __HAL_RCC_GPIOA_CLK_ENABLE();

}

/* USER CODE BEGIN 4 */

static void gpio_register_init(void) {
	RCC->AHB1ENR |= RCC_AHB1ENR_GPIOAEN | RCC_AHB1ENR_GPIOBEN | RCC_AHB1ENR_GPIOCEN;

	volatile uint32_t dummy_read = RCC->AHB1ENR;
	(void)dummy_read;

	GPIOA->MODER &= ~(3u << (LED_PIN_PA5*2));
	GPIOA->MODER |= (1u << (LED_PIN_PA5*2));

	GPIOB->MODER &= ~(0xFF00003Cu); //PB1, PB2, PB12-15
	GPIOB->MODER |= (0x55u << (LED_PIN_PB12*2)); //PB12-15
	GPIOB->PUPDR |= 0x14u; //PB1-2

	GPIOC->MODER &= ~(3u << (BUTTON_PIN*2));
}

static void leds_show(uint32_t value) {
	GPIOB->BSRR = (value << LED_PIN_PB12); // ON
	GPIOB->BSRR = ((~value & 0xFu) << (LED_PIN_PB12 + 16)); //OFF
}

static void run_button_task(void) {
	uint32_t now_ms = HAL_GetTick();

	if ((now_ms - last_button_tick) < BUTTON_SAMPLE_MS) return;
	last_button_tick = now_ms;

	uint32_t idr = GPIOB->IDR;
	uint32_t addBtn = (idr >> BUTTON_ADD) & 1u;
	uint32_t subBtn = (idr >> BUTTON_SUB) & 1u;

	if (addBtn_last == 1u && addBtn == 0u)
		value = (value + 1u) & 0xFu;
	if (subBtn_last == 1u && subBtn == 0u)
		value = (value - 1u) & 0xFu;

	addBtn_last = addBtn;
	subBtn_last = subBtn;

	leds_show(value);
}

/* USER CODE END 4 */

void Error_Handler(void)
{
  __disable_irq();
  while (1)
  {
  }
}
